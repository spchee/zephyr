## dts/bindings/gpio/arm,cmsdk-gpio.yaml
```yaml
# Copyright 2025 Arm Limited and/or its affiliates <open-source-office@arm.com>
# SPDX-License-Identifier: Apache-2.0

description: ARM CMSDK GPIO

compatible: "arm,cmsdk-gpio"

include: [gpio-controller.yaml, base.yaml, pinctrl-device.yaml]

properties:
  reg:
    required: true

  interrupts:
    required: true

  "#gpio-cells":
    const: 2

gpio-cells:
  - pin
  - flags
```

## dts/bindings/serial/arm,cmsdk-uart.yaml
```yaml
# Copyright 2025 Arm Limited and/or its affiliates <open-source-office@arm.com>
# SPDX-License-Identifier: Apache-2.0

description: ARM CMSDK UART

compatible: "arm,cmsdk-uart"

include: [uart-controller.yaml, pinctrl-device.yaml]

properties:
  reg:
    required: true

  interrupts:
    required: true
```
